## sdkconfig.defaults.esp32s3
```kconfig
# ESP32-S3 USB/IP Server - optimized defaults
CONFIG_IDF_TARGET="esp32s3"
CONFIG_ESPTOOLPY_FLASHMODE_QIO=y
CONFIG_ESPTOOLPY_FLASHSIZE_16MB=y
CONFIG_PARTITION_TABLE_CUSTOM=y

# Compiler / CPU
CONFIG_COMPILER_OPTIMIZATION_PERF=y
CONFIG_COMPILER_CXX_EXCEPTIONS=y
CONFIG_COMPILER_CXX_RTTI=y
CONFIG_ESP_DEFAULT_CPU_FREQ_MHZ_240=y
CONFIG_ESP32S3_INSTRUCTION_CACHE_32KB=y
CONFIG_FREERTOS_HZ=1000

# Disable unused features (save Flash/RAM/CPU)
# CONFIG_ETH_ENABLED is not set
# CONFIG_LWIP_STATS is not set
# CONFIG_SPIRAM_MEMTEST is not set
# CONFIG_MBEDTLS_CERTIFICATE_BUNDLE is not set
# CONFIG_MBEDTLS_SELF_TEST is not set
# Note: LWIP_IPV6 must stay enabled — espressif/asio requires it

# PSRAM: Octal, WiFi/LwIP in PSRAM, reserve internal RAM for USB DMA
CONFIG_SPIRAM=y
CONFIG_SPIRAM_MODE_OCT=y
CONFIG_SPIRAM_XIP_FROM_PSRAM=y
CONFIG_SPIRAM_MALLOC_ALWAYSINTERNAL=0
CONFIG_SPIRAM_TRY_ALLOCATE_WIFI_LWIP=y
CONFIG_SPIRAM_MALLOC_RESERVE_INTERNAL=196608
CONFIG_SPIRAM_ALLOW_BSS_SEG_EXTERNAL_MEMORY=y
CONFIG_SPIRAM_ALLOW_NOINIT_SEG_EXTERNAL_MEMORY=y

# WiFi
CONFIG_ESP_WIFI_STATIC_RX_BUFFER_NUM=10
CONFIG_ESP_WIFI_RX_BA_WIN=6

# LWIP / TCP (USB/IP: few connections, larger recv window)
CONFIG_LWIP_MAX_SOCKETS=16
CONFIG_LWIP_MAX_ACTIVE_TCP=8
CONFIG_LWIP_MAX_LISTENING_TCP=4
CONFIG_LWIP_TCP_OOSEQ_MAX_PBUFS=4
CONFIG_LWIP_TCP_WND_DEFAULT=11400
CONFIG_LWIP_TCPIP_TASK_STACK_SIZE=4096

# USB Host: Hub support + bias IN (device-to-host heavy workload)
CONFIG_USB_HOST_HUBS_SUPPORTED=y
CONFIG_USB_HOST_HW_BUFFER_BIAS_IN=y

CONFIG_PTHREAD_TASK_STACK_SIZE_DEFAULT=8192
```
